## components/jev_tools/Kconfig
```kconfig
menu "Jev minimal ESP32-S3-MINI-1 profile"

    comment "4 MB flash, no PSRAM required, USB Serial/JTAG console"

    comment "Avoid GPIO0,3,19,20,22-32,45,46; firmware rejects them"

    config JEV_LED_GPIO
        int "Digital output 'led' GPIO (-1 disables)"
        range -1 48
        default -1

    config JEV_RELAY_GPIO
        int "Digital output 'relay' GPIO (-1 disables)"
        range -1 48
        default -1

    config JEV_BUTTON_GPIO
        int "Digital input 'button' GPIO (-1 disables)"
        range -1 48
        default -1

    config JEV_ANALOG_GPIO
        int "ADC input 'analog' GPIO (-1 disables)"
        range -1 20
        default -1

    config JEV_PWM_GPIO
        int "PWM output 'fan' GPIO (-1 disables)"
        range -1 48
        default -1

    config JEV_SERVO_GPIO
        int "Servo output 'servo' GPIO (-1 disables)"
        range -1 48
        default -1

    config JEV_I2C_SDA_GPIO
        int "I2C SDA GPIO (-1 disables scan)"
        range -1 48
        default -1

    config JEV_I2C_SCL_GPIO
        int "I2C SCL GPIO (-1 disables scan)"
        range -1 48
        default -1

endmenu
```

## sdkconfig.defaults
```kconfig
CONFIG_IDF_TARGET="esp32s3"
CONFIG_ESP_CONSOLE_UART_DEFAULT=y
CONFIG_ESP_CONSOLE_SECONDARY_NONE=y
CONFIG_ESP_TASK_WDT_EN=y
CONFIG_ESP_TASK_WDT_INIT=y
CONFIG_COMPILER_OPTIMIZATION_SIZE=y
CONFIG_LOG_DEFAULT_LEVEL_WARN=y
CONFIG_LOG_DEFAULT_LEVEL=2
CONFIG_BT_ENABLED=y
CONFIG_BT_NIMBLE_ENABLED=y
CONFIG_BT_NIMBLE_MAX_CONNECTIONS=1
CONFIG_BT_NIMBLE_ROLE_CENTRAL=n
CONFIG_BT_NIMBLE_ROLE_OBSERVER=n
CONFIG_BT_NIMBLE_ROLE_PERIPHERAL=y
CONFIG_BT_NIMBLE_ROLE_BROADCASTER=y
CONFIG_BT_NIMBLE_SECURITY_ENABLE=y
CONFIG_BT_NIMBLE_SM_SC=y
CONFIG_BT_NIMBLE_SM_LEGACY=n
CONFIG_ESP_PROTOCOMM_SUPPORT_SECURITY_VERSION_1=y
CONFIG_NETWORK_PROV_NETWORK_TYPE_WIFI=y
CONFIG_NETWORK_PROV_BLE_SEC_CONN=y
CONFIG_NETWORK_PROV_BLE_FORCE_ENCRYPTION=y
CONFIG_ESPTOOLPY_FLASHSIZE_4MB=y
CONFIG_ESPTOOLPY_FLASHSIZE="4MB"
CONFIG_PARTITION_TABLE_CUSTOM=y
CONFIG_PARTITION_TABLE_CUSTOM_FILENAME="partitions.csv"
```
